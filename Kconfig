## Kconfig
```kconfig
mainmenu "NRC Verilator Configuration Menu"

#--------------------------------------
# CPU configuration
#--------------------------------------
menu "CPU configuration"

endmenu

#--------------------------------------
# Verilator configuration
#--------------------------------------

menu "Simulation configuration"


  menu "Trace"

  config ITRACE
    bool "Enable instruction trace."
    default y

  config ITRACE_WRITE_LOG
    depends on ITRACE
    bool "Write the instruction trace to a log file "
    default n

  config IRINGBUF_SIZE
    depends on ITRACE
    int "Instruction Ring buffer entry size"
    default 128

  config IRINGBUF_ENTRY
    depends on ITRACE
    int "Instruction Ring buffer entry"
    default 8

  config MTRACE
    bool "Enable memory trace"
    default y

  config MTRACE_WRITE_LOG
    depends on MTRACE
    bool "Write the memory trace to a log file"
    default n

  config MRINGBUF_SIZE
    depends on MTRACE
    int "Memory Ring buffer entry size"
    default 128

  config MRINGBUF_ENTRY
    depends on MTRACE
    int "Memory Ring buffer entry"
    default 8

  config MTRACE_START
    depends on MTRACE
    hex "Memory trace start address"
    default 0

  config MTRACE_END
    depends on MTRACE
    hex "Memory trace end address"
    default 0xFFFFFFFF

  config FTRACE
    bool "Enable function trace"
    default n

  config FTRACE_WRITE_LOG
    depends on FTRACE
    bool "Write the function trace to a log file"
    default n

  config FRINGBUF_SIZE
    depends on FTRACE
    int "Function Ring buffer entry size"
    default 256

  config FRINGBUF_ENTRY
    depends on FTRACE
    int "Function Ring buffer entry"
    default 8

  config STRACE
    bool "Enable system call trace"
    default n

  config STRACE_WRITE_LOG
    depends on STRACE
    bool "Write the system call trace to a log file"
    default n

  config SRINGBUF_SIZE
    depends on STRACE
    int "System call trace Ring buffer entry size"
    default 128

  config SRINGBUF_ENTRY
    depends on STRACE
    int "System call Ring buffer entry"
    default 8

  endmenu

  menu "Debug"

  config DIFFTEST
    bool "Enable difftest"
    default y

  config WAVE
    bool "Enable waveform dump"
    default n

  config WAVE_START
    depends on WAVE
    int "Wavefrom start cycle"
    default 0

  config WAVE_END
    depends on WAVE
    int "Wavefrom end cycle"
    default 1000

  endmenu


  menu "Device"

  config HAS_DEVICE
    bool "Enable device"
    default y

  config HAS_SERIAL
    depends on HAS_DEVICE
    bool "Enable serial device"
    default y

  config HAS_TIMER
    depends on HAS_DEVICE
    bool "Enable timer device"
    default y

  config HAS_KEYBOARD
    depends on HAS_DEVICE
    bool "Enable keyboard device"
    default y

  config HAS_VGACTL
    depends on HAS_DEVICE
    bool "Enable VGA"
    default y

  config VGA_SHOW_SCREEN
    depends on HAS_VGACTL
    bool "Show VGA screen using SDL "
    default y

  config HAS_AUDIO
    depends on HAS_DEVICE
    bool "Enable Audio"
    default y

  endmenu

endmenu
```
